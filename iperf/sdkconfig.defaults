## iperf/sdkconfig.defaults
```kconfig
CONFIG_LWIP_NETIF_STATUS_CALLBACK=y
CONFIG_LWIP_IPV6_AUTOCONFIG=y
CONFIG_LWIP_IPV6_DHCP6=y

CONFIG_FREERTOS_HZ=1000

# We increase this from its default priority of 1 so that the FreeRTOS timer service will be a
# higher priority than any of the thread created by MMOSAL (i.e. higher priority than
# MMOSAL_TASK_PRI_HIGH). See "Timers" section in the Morse Micro Operating System Abstraction Layer
# (mmosal) API docs.
CONFIG_FREERTOS_TIMER_TASK_PRIORITY=10

CONFIG_IDF_TARGET="esp32s3"

CONFIG_LWIP_IRAM_OPTIMIZATION=y
CONFIG_LWIP_TCP_MSS=1460
CONFIG_LWIP_TCP_SND_BUF_DEFAULT=8760
CONFIG_LWIP_TCP_WND_DEFAULT=14600
CONFIG_LWIP_TCP_RECVMBOX_SIZE=10
CONFIG_LWIP_UDP_RECVMBOX_SIZE=10

CONFIG_PARTITION_TABLE_SINGLE_APP_LARGE=y

CONFIG_MBEDTLS_NIST_KW_C=y
```

## sta_connect/sdkconfig.defaults
```kconfig
CONFIG_FREERTOS_HZ=1000

# We increase this from its default priority of 1 so that the FreeRTOS timer service will be a
# higher priority than any of the thread created by MMOSAL (i.e. higher priority than
# MMOSAL_TASK_PRI_HIGH). See "Timers" section in the Morse Micro Operating System Abstraction Layer
# (mmosal) API docs.
CONFIG_FREERTOS_TIMER_TASK_PRIORITY=10

CONFIG_IDF_TARGET="esp32s3"

CONFIG_MBEDTLS_NIST_KW_C=y
```
